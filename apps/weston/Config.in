## apps/weston/Config.in
```kconfig
menu "Configuration"
	depends on PACKAGE_weston

config WESTON_ENABLE_EGL
	bool "Enable EGL"
	default y
	help
	 Use EGL acceleration with Wayland

config WESTON_ENABLE_WAYLAND_COMPOSITOR
	bool "Build Wayland Compositor"
	default y
	help
	 Build wayland compositor

config WESTON_ENABLE_CAIRO_GLESV2
	bool "Use cairo with GLESv2 support"
	default n
	help
	 Uses cairo in GLESv2 mode instead of image mode. Not recommended.

config WESTON_ENABLE_FBDEV_COMPOSITOR
	bool "Build FBDev Compositor"
	default n
	help
	 Build a framebuffer compositor. If you enabled EGL, you might want to enable this.

config WESTON_ENABLE_XWAYLAND
	bool "Enable xwayland"
	default n
	help
	 XWayland supports X11 native applications on Wayland. Compatibility with X11.

config WESTON_ENABLE_LIBUNWIND
	bool "Use libunwind"
	default n
	help
	 Enables linking against libunwind (Requires libunwind). Libunwind only helps with weston crash reports and is safe to skip, if not intending to report bugs.

config WESTON_ENABLE_DBUS
	bool "Use DBUS"
	default n
	help
	 Equips DBUS (Requires dbus)

config WESTON_ENABLE_WESTON_LAUNCH
	bool "Build Weston Launch"
	default n
	help
	 Builds Weston Launch utility (Requires libpam)

endmenu
```

## weston/weston/Config.in
```kconfig
menu "Configuration"
	depends on PACKAGE_weston

config WESTON_ENABLE_FBDEV_COMPOSITOR
	bool "Build FBDev Compositor"
	default n
	help
	 Build a framebuffer compositor. If you enabled EGL, you might want to enable this.

config WESTON_ENABLE_XWAYLAND
	bool "Enable xwayland"
	default n
	help
	 XWayland supports X11 native applications on Wayland. Compatibility with X11.

config WESTON_ENABLE_LIBUNWIND
	bool "Use libunwind"
	default n
	help
	 Enables linking against libunwind (Requires libunwind). Libunwind only helps with weston crash reports and is safe to skip, if not intending to report bugs.

config WESTON_ENABLE_DBUS
	bool "Use DBUS"
	default n
	help
	 Equips DBUS (Requires dbus)

config WESTON_ENABLE_WESTON_LAUNCH
	bool "Build Weston Launch"
	default n
	help
	 Builds Weston Launch utility (Requires libpam)

endmenu
```
